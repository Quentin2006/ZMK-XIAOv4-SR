## boards/shields/skreecustom/Kconfig.shield
```kconfig
# No whitespace after the comma or in your part name!
config SHIELD_SKREECUSTOM_LEFT
    def_bool $(shields_list_contains,skreecustom_left)

# No whitespace after the comma or in your part name!
config SHIELD_SKREECUSTOM_RIGHT
    def_bool $(shields_list_contains,skreecustom_right)
```

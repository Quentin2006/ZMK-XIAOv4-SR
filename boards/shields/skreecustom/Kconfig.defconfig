## boards/shields/skreecustom/Kconfig.defconfig
```kconfig
if SHIELD_SKREECUSTOM_LEFT

config ZMK_KEYBOARD_NAME
    default "Skree Custom"

config ZMK_SPLIT_ROLE_CENTRAL
    default y

endif

if SHIELD_SKREECUSTOM_LEFT || SHIELD_SKREECUSTOM_RIGHT

config ZMK_SPLIT
    default y

config ZMK_SLEEP
    default y

config ZMK_POINTING
    default y

config SPI
    default y

config ZMK_RGB_UNDERGLOW
    default y
    imply WS2812_STRIP

config ZMK_RGB_UNDERGLOW_EXT_POWER
    default n

config ZMK_KSCAN_MATRIX_WAIT_BEFORE_INPUTS
    default 0

config ZMK_KSCAN_MATRIX_WAIT_BETWEEN_OUTPUTS
    default 1


endif
```
